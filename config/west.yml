## config/west.yml
```yaml
manifest:
  remotes:
    - name: zmkfirmware
      url-base: https://github.com/zmkfirmware
  projects:
    - name: zmk
      remote: pete
      revision: feat/pointers-with-input-processors
      import: app/west.yml
  self:
    path: config
```
